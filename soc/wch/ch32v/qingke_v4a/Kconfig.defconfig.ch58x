## soc/wch/ch32v/qingke_v4a/Kconfig.defconfig.ch58x
```kconfig
# Copyright (c) 2025 MASSDRIVER EI (massdriver.space)
# SPDX-License-Identifier: Apache-2.0

if SOC_CH582

config VECTOR_TABLE_SIZE
	default 35

config NUM_IRQS
	default 35

endif # SOC_CH582
```

## soc/wch/ch32v/qingke_v4a/Kconfig.soc
```kconfig
# Copyright (c) 2025 MASSDRIVER EI (massdriver.space)
# SPDX-License-Identifier: Apache-2.0

config SOC_SERIES_QINGKE_V4A
	bool
	select SOC_FAMILY_CH32V

config SOC_SERIES
	default "qingke_v4a" if SOC_SERIES_QINGKE_V4A

rsource "Kconfig.soc.*"
```

## soc/wch/ch32v/qingke_v4a/Kconfig.soc.ch58x
```kconfig
# Copyright (c) 2025 MASSDRIVER EI (massdriver.space)
# SPDX-License-Identifier: Apache-2.0

config SOC_CH582
	bool
	select SOC_SERIES_QINGKE_V4A

config SOC
	default "ch582" if SOC_CH582
```
